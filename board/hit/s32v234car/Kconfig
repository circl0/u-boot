## board/hit/s32v234car/Kconfig
```kconfig
# (C) Copyright 2017 MicroSys Electronics GmbH
# (C) Copyright 2018 HIT

if TARGET_S32V234CAR

config SYS_BOARD
	string
	default "s32v234car"

config SYS_VENDOR
	string
	default "hit"

config SYS_CONFIG_NAME
	string
	default "s32v234car"

# S32V234CAR board with DDR3 has 4x512 MB DDR chips
# DDR0(1024MB) and DDR1(1024MB).
# U-boot uses only one DDR slot for the boards which don't have
# the DDR slots mapped as contiguous memory, otherwise uses
# both DDR slots.

config SYS_DDR_SIZE
	int
	default 2147483648 if S32_DDR3
	default 268435456 if S32_LPDDR2

config PHY_RGMII_DIRECT_CONNECTED
	bool "Enable fixed PHY for MDIO Bus/PHY emulation with fixed speed/link PHYs"
	default n
	help
	  Adds the platform "fixed" MDIO Bus to cover the boards that
	  use PHYs that are not connected to the real MDIO bus.

config S32V234_FAST_BOOT
	bool "Configure DCD and RUNMODE for a fast-boot efused board"
	default n
	help
	  Configure DCD and RUNMODE for a board that has been efused such that
	  OCOTP_CFG6:[19]FAST_BOOT_ENABLE = 0 and OCOTP_CFG6:[18]NO_PLL = 1.

endif
```
